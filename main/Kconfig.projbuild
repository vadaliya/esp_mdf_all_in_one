## main/Kconfig.projbuild
```kconfig
menu "Example Configuration"

choice DEVICE_TYPE
    bool "Configure the device type"
    default DEVICE_TYPE_NODE
    help
        Configure the device type

config DEVICE_TYPE_ROOT
   bool "Root device"
config DEVICE_TYPE_NODE
   bool "Non-Root device"
endchoice

config DEVICE_TYPE
    int
    default 1 if DEVICE_TYPE_ROOT
    default 2 if DEVICE_TYPE_NODE    
    
config ROUTER_SSID
    string "Router SSID"
        default "ROUTER_SSID"
        help
            Router SSID.

config ROUTER_PASSWORD
    string "Router password"
        default "ROUTER_PASSWORD"
        help
            Router password.

config MESH_ID
    string "Mesh ID"
        default "123456"
        help
            Mesh network identification, Nodes with the same mesh ID can
            communicate with each other.

config MESH_PASSWORD
    string "Mesh Password"
    default "MESH_PASSWORD"
    help
        Mesh AP password. Password length must be 8 bits smaller than 64 bits,Set to null to not encrypt

config SERVER_IP
    string "Server IP address"
        default "192.168.0.1"
        help
            Server IP address.

config SERVER_PORT
    int "Server port"
        default "8070"
        help
            Server port.

endmenu
```
